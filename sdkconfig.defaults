## sdkconfig.defaults
```kconfig
CONFIG_ESPTOOLPY_FLASHFREQ_80M=y
CONFIG_ESPTOOLPY_FLASHFREQ="80m"
CONFIG_ESPTOOLPY_FLASHSIZE_16MB=y
CONFIG_ESPTOOLPY_FLASHSIZE="16MB"
CONFIG_I2C_MANAGER_0_ENABLED=y
CONFIG_I2C_MANAGER_0_SDA=21
CONFIG_I2C_MANAGER_0_SCL=22
CONFIG_I2C_MANAGER_0_FREQ_HZ=1000000
CONFIG_LV_INDEV_DEF_READ_PERIOD=10
CONFIG_LV_HOR_RES_MAX=320
CONFIG_LV_VER_RES_MAX=240
CONFIG_LV_COLOR_16_SWAP=y
CONFIG_LV_USE_USER_DATA=y
CONFIG_LV_USE_PERF_MONITOR=y
CONFIG_LV_PREDEFINED_DISPLAY_M5CORE2=y
CONFIG_LV_TOUCH_CONTROLLER=2
CONFIG_LV_TOUCH_CONTROLLER_FT6X06=y
CONFIG_LV_I2C_TOUCH=y
CONFIG_LV_I2C_TOUCH_0=y
CONFIG_LV_FT6X36_SWAPXY=n
CONFIG_LV_FT6X36_INVERT_Y=n
```
